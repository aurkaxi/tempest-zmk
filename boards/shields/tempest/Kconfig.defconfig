## boards/shields/tempest/Kconfig.defconfig
```kconfig
if SHIELD_TEMPEST_DONGLE

config ZMK_KEYBOARD_NAME
    default "TEMPEST"

config ZMK_SPLIT_ROLE_CENTRAL
    default y

config ZMK_SPLIT
    default y

config ZMK_SPLIT_BLE_CENTRAL_PERIPHERALS
    default 2

config BT_MAX_CONN
    default 7

config BT_MAX_PAIRED
    default 7

endif

if SHIELD_TEMPEST_LEFT || SHIELD_TEMPEST_RIGHT

config ZMK_SPLIT
    default y

endif
```
